/*
  Created 2016
  by AlexGyver
  AlexGyver Home Labs Inc.  
*/
#include <avr/sleep.h>            //библиотека режимов сна

volatile unsigned long lastshot;  //время последнего выстрела для таймера сна

boolean trig_state;            //переменная для хранения текущего состояняи кнопки
boolean flag;                  //флажок для запоминания положения кнопки
boolean trigger;               //положение спусковой кнопки
boolean mode;                  //положение смены типа стрельбы  авто(1) / одиночные (0)

byte del_shot = 10;             //задержка клапана, миллисекунды
byte n_shots=3;                //число выстрелов в очереди, при стрельбе очередью

byte mode_pin = 12;            //кнопка переключения режимов на D12 (необязательная, без неё код тоже будет работать)
byte trigger_pin = 2;          //спусковая кнопка на D2
byte solen_pin = 8;            //перезаряжающий соленоид на D8
byte valve_pin = 3;            //реле или мосфет на D3
boolean signal_shot = 1;       //если используете МОСФЕТ или прямое реле, то цифра 1. Если обратное реле, то цифра 0 !!

void setup() {
  Serial.begin(9600);
  pinMode(mode_pin, INPUT_PULLUP);            //пин кнопки режимов огня подтянут внутренним резистором (резистор на 10 кОм НЕ НУЖЕН)
  pinMode(trigger_pin, INPUT_PULLUP);         //пин кнопки подтянут внутренним резистором (резистор на 10 кОм НЕ НУЖЕН)
  pinMode(valve_pin, OUTPUT);                 //сформировать пин клапана как выход
  digitalWrite(valve_pin, !signal_shot);      //поставить клапан в закрытое положение (для компенсации прямого и обратного реле)
  pinMode(solen_pin, OUTPUT);                 //сформировать пин соленоида как выход
  attachInterrupt(0, trigger_press, FALLING); //аппаратное прерывание при нажатии на кнопку (выстрел = проснуться)
}

void shot() { //функция выстрела
  digitalWrite(valve_pin, signal_shot);   //открыть клапан
  delay(del_shot);                        //подождать время, равное del
  digitalWrite(valve_pin, !signal_shot);  //закрыть клапан
  delay(10);                              //подождать немного, чтобы воздух вышел из ствола
  digitalWrite(solen_pin, 1);             //открыть затвор
  delay(40);                              //подождать пока затвор откроется
  digitalWrite(solen_pin, 0);             //закрыть затвор
  delay(40);                              //ждать пока затвор закроется
  lastshot = millis();                    //запомнить время последнего выстрела (для таймера сна)
}

void loop() {
  trig_state = digitalRead(trigger_pin); //считать положение спусковой кнопки

  if (digitalRead(mode_pin) == 1) {     //считать положение кнопки переключения режимов
    mode = 0;
  } else {
    mode = 1;
  }

  if (trig_state == 0 && mode == 0 && flag == 0) { //если спусковая кнопка нажата, выбран режим стрельбы ОДИНОЧНЫМИ и флаг=0
    shot();
    flag = 1;                                      //поставить флажок, что кнопка нажата
  }

  if (trig_state == 1 && mode == 0 && flag == 1) { //если кнопка отжата, выбран режим стрельбы ОДИНОЧНЫМИ и флаг=1
    flag = 0;  //ставим флажок, что кнопка больше не нажата
  }

  if (trig_state == 0 && mode == 1 && flag == 0) { //если спусковая кнопка нажата, выбран АВТОМАТИЧЕСКИЙ режим стрельбы и флаг=0
    for (int i=0; i<n_shots; i++) {
      shot();                                      // выстрел и перезарядка
    }
  }

  // этот кусок даёт команду спать
  if (millis() - lastshot > 3000) {        // если после последнего выстрела прошло больше 3 секунд
    set_sleep_mode(SLEEP_MODE_PWR_DOWN);   // выбор режима энергопотребления
    sleep_mode();                          // уходим в спячку
  }
  // конец куска

  delay(1);       //задержка для стабильности работы прошивки
}

void trigger_press() { // обработчик прерывания
                       //просыпаемся при нажатии кнопки!
}
